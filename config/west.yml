## config/west.yml
```yaml
manifest:
  remotes:
    - name: zmkfirmware
      url-base: https://github.com/LOWPROKB
    - name: patch
      url-base: https://github.com/caksoylar
  projects:
    - name: zmk
      remote: patch
      revision: zen
      import: app/west.yml
  self:
    path: config
```
